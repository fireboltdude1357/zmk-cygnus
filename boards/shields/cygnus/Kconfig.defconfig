## boards/shields/cygnus/Kconfig.defconfig
```kconfig
if SHIELD_CYGNUS_LEFT

config ZMK_KEYBOARD_NAME
9b5eb3c    default "Cygnus-v2"

config ZMK_SPLIT_ROLE_CENTRAL
    default y

endif

if SHIELD_CYGNUS_LEFT || SHIELD_CYGNUS_RIGHT

config ZMK_SPLIT
    default y

endif
```
