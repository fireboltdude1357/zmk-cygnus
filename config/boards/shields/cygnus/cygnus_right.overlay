#include "cygnus.dtsi"

&kscan0 {
    col-gpios
        = <&gpio0 99 GPIO_ACTIVE_HIGH>
        , <&gpio0 99 GPIO_ACTIVE_HIGH>
        , <&gpio0 99 GPIO_ACTIVE_HIGH>
        , <&gpio0 99 GPIO_ACTIVE_HIGH>
        , <&gpio0 99 GPIO_ACTIVE_HIGH>
        , <&gpio0 99 GPIO_ACTIVE_HIGH>
        ;
     row-gpios
        = <&gpio0 99 (GPIO_ACTIVE_HIGH | GPIO_PULL_DOWN)>
        , <&gpio0 99 (GPIO_ACTIVE_HIGH | GPIO_PULL_DOWN)>
        , <&gpio0 99 (GPIO_ACTIVE_HIGH | GPIO_PULL_DOWN)>
        , <&gpio0 99 (GPIO_ACTIVE_HIGH | GPIO_PULL_DOWN)>
        ;
};

